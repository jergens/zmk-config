## config/west.yml
```yaml
manifest:
  remotes:
    - name: zmkfirmware
      url-base: https://github.com/zmkfirmware
  projects:
    - name: petejohanson
      remote: zmk
      revision: core/zephyr-3.4-update
      import: app/west.yml
  self:
    path: config
```
